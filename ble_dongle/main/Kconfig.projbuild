## ble_dongle/main/Kconfig.projbuild
```kconfig
menu "BLE dongle"

config DONGLE_BAUD_RATE
    int "Baud rate of the host's serial port"
    default 115200

config ZZ_BLE_DEV_PIN
    int "Developer PIN"
    range 0 999999
    default 0
    help
        PIN for pairing when "!dongle link" names none; the same option as in Lizard, so sdkconfig.defaults.secret applies.

config DONGLE_SVC_UUID
    string "Service UUID of Lizard's Bluetooth module"
    default "23014ccc-4677-4864-b4c1-8f772b373fac"

config DONGLE_CONSOLE_IN_UUID
    string "Console input characteristic UUID"
    default "75cdc16b-212b-4176-8bb8-4222f21cc826"

config DONGLE_CONSOLE_OUT_UUID
    string "Console output characteristic UUID"
    default "f8f511b2-1401-4e28-82f1-ad753df3b750"

config DONGLE_CONSOLE_FLOW_UUID
    string "Console flow characteristic UUID"
    default "d1e7616c-a8ac-4ec8-9c49-3ae32a008a89"

endmenu
```

## ble_dongle/sdkconfig.defaults
```kconfig
# the host's serial port carries nothing but the robot's console
CONFIG_ESP_CONSOLE_NONE=y
CONFIG_LOG_DEFAULT_LEVEL_NONE=y
CONFIG_BOOTLOADER_LOG_LEVEL_NONE=y
CONFIG_FREERTOS_HZ=1000
CONFIG_ESP_DEFAULT_CPU_FREQ_MHZ_240=y

CONFIG_BT_ENABLED=y
CONFIG_BT_NIMBLE_ENABLED=y
CONFIG_BTDM_CTRL_MODE_BLE_ONLY=y
CONFIG_BT_NIMBLE_ROLE_CENTRAL=y
CONFIG_BT_NIMBLE_ROLE_OBSERVER=y
# CONFIG_BT_NIMBLE_ROLE_PERIPHERAL is not set
# CONFIG_BT_NIMBLE_ROLE_BROADCASTER is not set
CONFIG_BT_NIMBLE_MAX_CONNECTIONS=1
CONFIG_BT_NIMBLE_NVS_PERSIST=y
CONFIG_BT_NIMBLE_SECURITY_ENABLE=y
CONFIG_BT_NIMBLE_ATT_PREFERRED_MTU=256
CONFIG_BT_NIMBLE_HOST_TASK_STACK_SIZE=6144
CONFIG_BT_NIMBLE_LOG_LEVEL_NONE=y
```

## main/Kconfig.projbuild
```kconfig
menu "Zeug BLE command module"

config ZZ_BLE_COM_SVC_UUID
    string
    prompt "Service UUID"
    default "23014ccc-4677-4864-b4c1-8f772b373fac"
    help
        The component defines a single BLE service; this is its UUID. Within the service two characteristics are defined, one writable (for receiving commands) and one readable (for sending replies).

config ZZ_BLE_COM_CHR_UUID
    string
    prompt "Command characteristic UUID"
    default "37107598-7030-46d3-b688-e3664c1712f0"
    help
        UUID of the writable characteristic for receiving commands.

config ZZ_BLE_COM_SEND_CHR_UUID
    string
    prompt "Reply characteristic UUID"
    default "19f91f52-e3b1-4809-9d71-bc16ecd81069"
    help
        UUID of the readable characteristic. Replies are always only sent via notifications, so do not perform reads on it.

config ZZ_BLE_COM_CONSOLE_IN_CHR_UUID
    string
    prompt "Console input characteristic UUID"
    default "75cdc16b-212b-4176-8bb8-4222f21cc826"
    help
        UUID of the writable characteristic that takes console lines as a byte stream, each line terminated by a newline.

config ZZ_BLE_COM_CONSOLE_OUT_CHR_UUID
    string
    prompt "Console output characteristic UUID"
    default "f8f511b2-1401-4e28-82f1-ad753df3b750"
    help
        UUID of the characteristic that streams every console line via notifications to an authenticated central.

config ZZ_BLE_COM_CONSOLE_FLOW_CHR_UUID
    string
    prompt "Console flow characteristic UUID"
    default "d1e7616c-a8ac-4ec8-9c49-3ae32a008a89"
    help
        UUID of the characteristic that notifies how many console input bytes and lines the robot has processed, so that a sender can keep its writes within the robot's queue.

config ZZ_BLE_DEV_PIN
    int "Developer PIN"
    range 0 999999
    help
        Hardcoded developer PIN for system access (numeric, 0-999999). This PIN provides administrative access to the device.

endmenu
```
